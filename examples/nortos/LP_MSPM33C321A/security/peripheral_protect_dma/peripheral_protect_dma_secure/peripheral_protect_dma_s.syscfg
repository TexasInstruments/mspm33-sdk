/**
 * @cliArgs --device "MSPM33C321X" --part "Default" --package "LQFP-100(PFA)" --product "mspm33_sdk@1.01.01.00"
 * @versions {"tool":"1.26.0+4341"}
 */
// @cliArgs --board /ti/boards/LP_MSPM33C321A --rtos nortos

/**
 * Import the modules used in this configuration.
 */
const DMA           = scripting.addModule("/ti/driverlib/DMA", {}, false);
const DMA1          = DMA.addInstance();
const GPIO          = scripting.addModule("/ti/driverlib/GPIO", {}, false);
const GPIO1         = GPIO.addInstance();
const GSC           = scripting.addModule("/ti/driverlib/GSC", {}, false);
const GSC1          = GSC.addInstance();
const SYSCTL        = scripting.addModule("/ti/driverlib/SYSCTL");
const ProjectConfig = scripting.addModule("/ti/project_config/ProjectConfig");

/**
 * Write custom configuration values to the imported modules.
 */
DMA1.$name                                    = "DMA0";
DMA1.associatedChannels.create(1);
DMA1.associatedChannels[0].$name              = "CH0";
DMA1.associatedChannels[0].transferMode       = "SINGLE_BLOCK";
DMA1.associatedChannels[0].destIncrement      = "INCREMENT";
DMA1.associatedChannels[0].addressMode        = "fill";
DMA1.associatedChannels[0].fillIncAmount      = "BYTE";
DMA1.associatedChannels[0].enableInterrupt    = true;
DMA1.associatedChannels[0].peripheral.$assign = "DMA0_CH0";

const Board = scripting.addModule("/ti/driverlib/Board", {}, false);

GPIO1.$name                               = "GPIO_LEDS";
GPIO1.associatedPins.create(2);
GPIO1.associatedPins[0].$name             = "PASS_LED";
GPIO1.associatedPins[0].launchPadShortcut = "LED2GreenEn";
GPIO1.associatedPins[1].$name             = "FAIL_LED";
GPIO1.associatedPins[1].launchPadShortcut = "LED2RedEn";

GSC1.$name           = "CONFIG_GSC_0";
GSC1.privileged_dma1 = true;
GSC1.secure_sram_size     = 64;
GSC1.privileged_sram_size = 256;

SYSCTL.forceDefaultClkConfig = true;

ProjectConfig.migrationCondition = true;
ProjectConfig.genLinker          = false;
ProjectConfig.genStartup         = false;
ProjectConfig.genOpts            = false;
ProjectConfig.genLibs            = false;

/**
 * Pinmux solution for unlocked pins/peripherals. This ensures that minor changes to the automatic solver in a future
 * version of the tool will not impact the pinmux you originally saw.  These lines can be completely deleted in order to
 * re-solve from scratch.
 */
Board.peripheral.$suggestSolution            = "DEBUGSS";
Board.peripheral.swclkPin.$suggestSolution   = "PA20";
Board.peripheral.swdioPin.$suggestSolution   = "PA19";
GPIO1.associatedPins[0].pin.$suggestSolution = "PC27";
GPIO1.associatedPins[1].pin.$suggestSolution = "PC26";
SYSCTL.peripheral.$suggestSolution           = "SYSCTL";
