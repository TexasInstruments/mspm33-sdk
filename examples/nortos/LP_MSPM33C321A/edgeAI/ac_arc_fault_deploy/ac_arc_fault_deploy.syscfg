/**
 * @cliArgs --device "MSPM33C321X" --part "Default" --package "LQFP-100(PFA)" --product "mspm33_sdk@1.02.00.00"
 * @versions {"tool":"1.26.0+4407"}
 */
// @cliArgs --board /ti/boards/LP_MSPM33C321A --rtos nortos

/**
 * Import the modules used in this configuration.
 */
const DMA           = scripting.addModule("/ti/driverlib/DMA", {}, false);
const DMA1          = DMA.addInstance();
const GPIO          = scripting.addModule("/ti/driverlib/GPIO", {}, false);
const GPIO1         = GPIO.addInstance();
const HSADC         = scripting.addModule("/ti/driverlib/HSADC", {}, false);
const HSADC1        = HSADC.addInstance();
const SYSCTL        = scripting.addModule("/ti/driverlib/SYSCTL");
const TIMER         = scripting.addModule("/ti/driverlib/TIMER", {}, false);
const TIMER1        = TIMER.addInstance();
const ProjectConfig = scripting.addModule("/ti/project_config/ProjectConfig");

/**
 * Write custom configuration values to the imported modules.
 */
DMA1.$name                                    = "DMA0";
DMA1.associatedChannels.create(1);
DMA1.associatedChannels[0].$name              = "CH0";
DMA1.associatedChannels[0].triggerSelect      = "ADC0";
DMA1.associatedChannels[0].addressMode        = "f2b";
DMA1.associatedChannels[0].transferMode       = "FULL_CH_REPEAT_SINGLE";
DMA1.associatedChannels[0].destIncrement      = "INCREMENT";
DMA1.associatedChannels[0].enableInterrupt    = true;
DMA1.associatedChannels[0].peripheral.$assign = "DMA0_CH0";

const Board = scripting.addModule("/ti/driverlib/Board", {}, false);

GPIO1.$name                               = "GPIO_GRP_0";
GPIO1.associatedPins[0].$name             = "PIN_0";
GPIO1.associatedPins[0].launchPadShortcut = "LED2RedEn";

HSADC1.$name                             = "HSADC0";
HSADC1.enabledSEQs                       = ["ADC_SEQ_NUMBER1"];
HSADC1.enabledDMAInts                    = ["ADC_INT_NUMBER_1"];
HSADC1.enableDMAInterrupt1               = true;
HSADC1.enableDMAInterrupt1ContinuousMode = true;
HSADC1.seq1TriggerSel                    = "ADC_TRIGGER_GEN_SUB_0";
HSADC1.seq1Enable                        = true;
HSADC1.ADCsubscriber1Channel             = 1;
HSADC1.enabledInts                       = ["ADC_INT_NUMBER_1"];
HSADC1.interruptPulseMode                = "ADC_PULSE_END_OF_CONV";
HSADC1.seqEndSOC                         = "ADC_SOC_NUMBER1";
HSADC1.enabledSOCs                       = ["ADC_SOC_NUMBER0","ADC_SOC_NUMBER1"];
HSADC1.peripheral.$assign                = "ADC0";


TIMER1.$name                       = "TIMER_0";
TIMER1.timerClkPrescale            = 256;
TIMER1.timerPeriod                 = "500 ms";
TIMER1.timerMode                   = "PERIODIC";
TIMER1.interrupts                  = ["ZERO"];
TIMER1.timerStartTimer             = true;
TIMER1.event1PublisherChannel      = 1;
TIMER1.event1ControllerInterruptEn = ["ZERO_EVENT"];

ProjectConfig.genLibCMSIS = true;

/**
 * Pinmux solution for unlocked pins/peripherals. This ensures that minor changes to the automatic solver in a future
 * version of the tool will not impact the pinmux you originally saw.  These lines can be completely deleted in order to
 * re-solve from scratch.
 */
Board.peripheral.$suggestSolution            = "DEBUGSS";
Board.peripheral.swclkPin.$suggestSolution   = "PA20";
Board.peripheral.swdioPin.$suggestSolution   = "PA19";
GPIO1.associatedPins[0].pin.$suggestSolution = "PC26";
SYSCTL.peripheral.$suggestSolution           = "SYSCTL";
TIMER1.peripheral.$suggestSolution           = "TIMA0_0";
