/**
 * @cliArgs --device "MSPM33C321X" --part "Default" --package "LQFP-100(PFA)" --product "mspm33_sdk@1.01.01.00"
 * @versions {"tool":"1.25.0+4268"}
 */
// @cliArgs --board /ti/boards/LP_MSPM33C321A --rtos nortos

/**
 * Import the modules used in this configuration.
 */
const AESADV        = scripting.addModule("/ti/driverlib/AESADV");
const GPIO          = scripting.addModule("/ti/driverlib/GPIO", {}, false);
const GPIO1         = GPIO.addInstance();
const NONMAIN       = scripting.addModule("/ti/driverlib/NONMAIN");
const ProjectConfig = scripting.addModule("/ti/project_config/ProjectConfig");

/**
 * Write custom configuration values to the imported modules.
 */
AESADV.enabledInterrupts = ["DL_AESADV_INTERRUPT_INPUT_CONTEXT_READY","DL_AESADV_INTERRUPT_INPUT_READY","DL_AESADV_INTERRUPT_OUTPUT_READY","DL_AESADV_INTERRUPT_SAVED_OUTPUT_CONTEXT_READY"];
AESADV.mode              = "DL_AESADV_MODE_GCM_LOAD_HASH_KEY";
AESADV.lowerCryptoLength = 0x3C;
AESADV.aadLength         = 0x14;

const Board = scripting.addModule("/ti/driverlib/Board", {}, false);

GPIO1.$name                               = "GPIO_LEDS";
GPIO1.associatedPins.create(2);
GPIO1.associatedPins[0].launchPadShortcut = "LED2GreenEn";
GPIO1.associatedPins[0].$name             = "PASS_LED";
GPIO1.associatedPins[1].$name             = "FAIL_LED";
GPIO1.associatedPins[1].launchPadShortcut = "LED2RedEn";

NONMAIN.nonmainWarning = true;
NONMAIN.cscExists      = true;

const SYSCTL = scripting.addModule("/ti/driverlib/SYSCTL", {}, false);

ProjectConfig.migrationCondition = true;
ProjectConfig.genLinker          = false;

/**
 * Pinmux solution for unlocked pins/peripherals. This ensures that minor changes to the automatic solver in a future
 * version of the tool will not impact the pinmux you originally saw.  These lines can be completely deleted in order to
 * re-solve from scratch.
 */
Board.peripheral.$suggestSolution            = "DEBUGSS";
Board.peripheral.swclkPin.$suggestSolution   = "PA20";
Board.peripheral.swdioPin.$suggestSolution   = "PA19";
GPIO1.associatedPins[0].pin.$suggestSolution = "PC27";
GPIO1.associatedPins[1].pin.$suggestSolution = "PC26";
SYSCTL.peripheral.$suggestSolution           = "SYSCTL";
