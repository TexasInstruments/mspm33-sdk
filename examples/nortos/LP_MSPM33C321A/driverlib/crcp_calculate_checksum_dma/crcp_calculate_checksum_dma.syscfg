//@cliArgs --device "MSPM33C321A" --package "LQFP-100(PFA)" --part "Default"
//@v2CliArgs --device "MSPM33C321A" --package "LQFP-100(PFA)"
// @cliArgs --board /ti/boards/LP_MSPM33C321A --rtos nortos


/**
 * Import the modules used in this configuration.
 */
const CRCP  = scripting.addModule("/ti/driverlib/CRCP");
const DMA   = scripting.addModule("/ti/driverlib/DMA", {}, false);
const DMA1  = DMA.addInstance();
const GPIO  = scripting.addModule("/ti/driverlib/GPIO", {}, false);
const GPIO1 = GPIO.addInstance();


/**
 * Write custom configuration values to the imported modules.
 */
CRCP.polynomial                      = "16_POLYNOMIAL_AUG_CCIT";
CRCP.seed                            = 0xF1D;
CRCP.endianness                      = "BIG_ENDIAN";
CRCP.enableCRCCalcWithDMA            = true;
CRCP.DMA_CHANNEL_CRC.$name           = "CH0";
CRCP.DMA_CHANNEL_CRC.srcLength       = "HALF_WORD";
CRCP.DMA_CHANNEL_CRC.dstLength       = "HALF_WORD";
CRCP.DMA_CHANNEL_CRC.enableInterrupt = true;

const Board = scripting.addModule("/ti/driverlib/Board", {}, false);

DMA1.$name = "DMA0";

GPIO1.$name                               = "GPIO_LEDS";
GPIO1.associatedPins.create(2);
GPIO1.associatedPins[0].$name             = "PASS_LED";
GPIO1.associatedPins[0].launchPadShortcut = "LED2GreenEn";
GPIO1.associatedPins[1].$name             = "FAIL_LED";
GPIO1.associatedPins[1].launchPadShortcut = "LED2RedEn";

const SYSCTL = scripting.addModule("/ti/driverlib/SYSCTL", {}, false);

const ProjectConfig              = scripting.addModule("/ti/project_config/ProjectConfig", {}, false);
ProjectConfig.migrationCondition = true;

ProjectConfig.genLinker  = true;
ProjectConfig.genStartup = true;
ProjectConfig.genOpts    = true;
ProjectConfig.genLibs    = true;
